## drivers/mtd/maps/Config.in
```kconfig
# drivers/mtd/maps/Config.in

# $Id: Config.in,v 1.34 2002/08/08 06:22:53 gerg Exp $

mainmenu_option next_comment

comment 'Mapping drivers for chip access'

dep_tristate '  CFI Flash device in physical memory map' CONFIG_MTD_PHYSMAP $CONFIG_MTD_GEN_PROBE
if [ "$CONFIG_MTD_PHYSMAP" = "y" -o "$CONFIG_MTD_PHYSMAP" = "m" ]; then
   hex '    Physical start address of flash mapping' CONFIG_MTD_PHYSMAP_START 0x8000000
   hex '    Physical length of flash mapping' CONFIG_MTD_PHYSMAP_LEN 0x4000000
   int '    Bus width in octets' CONFIG_MTD_PHYSMAP_BUSWIDTH 2
fi

dep_tristate '  Generic uClinux RAM/ROM filesystem support' CONFIG_MTD_UCLINUX $CONFIG_MTD_PARTITIONS
dep_tristate '  CFI Flash device mapped on Dragonix VZ' CONFIG_MTD_DRAGONIX $CONFIG_MTD_CFI_INTELEXT $CONFIG_MTD_CFI_AMDSTD $CONFIG_MTD_PARTITIONS
dep_tristate '  CFI Flash device mapped on SnapGear/SecureEdge' CONFIG_MTD_NETtel $CONFIG_MTD_PARTITIONS
dep_tristate '  CFI Flash device mapped on SnapGear/SecureEdge (uClinux)' CONFIG_MTD_NETteluC $CONFIG_UCLINUX $CONFIG_MTD_PARTITIONS
if [ "$CONFIG_MTD_NETteluC" = "y" ]; then
   choice '  FLASH size' \
           " AUTO  CONFIG_FLASHAUTO \
            128KB  CONFIG_FLASH128KB \
              1MB  CONFIG_FLASH1MB \
              2MB  CONFIG_FLASH2MB \
              4MB  CONFIG_FLASH4MB \
              6MB  CONFIG_FLASH6MB \
              8MB  CONFIG_FLASH8MB \
             16MB  CONFIG_FLASH16MB" AUTO
fi
dep_tristate '  CFI Flash device mapped on Key Technology devices' CONFIG_MTD_KEYTECHNOLOGY $CONFIG_UCLINUX $CONFIG_MTD_PARTITIONS
if [ "$CONFIG_SPARC" = "y" -o "$CONFIG_SPARC64" = "y" ]; then
   dep_tristate '  Sun Microsystems userflash support' CONFIG_MTD_SUN_UFLASH $CONFIG_MTD_CFI
fi

if [ "$CONFIG_X86" = "y" ]; then
   dep_tristate '  CFI Flash device mapped on Photron PNC-2000' CONFIG_MTD_PNC2000 $CONFIG_MTD_CFI $CONFIG_MTD_PARTITIONS
   dep_tristate '  CFI Flash device mapped on AMD SC520 CDP' CONFIG_MTD_SC520CDP $CONFIG_MTD_CFI
   dep_tristate '  CFI Flash device mapped on AMD NetSc520'  CONFIG_MTD_NETSC520 $CONFIG_MTD_CFI $CONFIG_MTD_PARTITIONS
   dep_tristate '  CFI Flash device mapped on Arcom SBC-GXx boards' CONFIG_MTD_SBC_GXX $CONFIG_MTD_CFI_INTELEXT $CONFIG_MTD_PARTITIONS
   dep_tristate '  CFI Flash device mapped on Arcom ELAN-104NC' CONFIG_MTD_ELAN_104NC $CONFIG_MTD_CFI_INTELEXT $CONFIG_MTD_PARTITIONS
   dep_tristate '  CFI Flash device mapped on DIL/Net PC' CONFIG_MTD_DILNETPC $CONFIG_MTD_CFI_INTELEXT $CONFIG_MTD_PARTITIONS $CONFIG_MTD_CONCAT
   if [ "$CONFIG_MTD_DILNETPC" = "y" -o "$CONFIG_MTD_DILNETPC" = "m" ]; then
     hex '    Size of boot partition' CONFIG_MTD_DILNETPC_BOOTSIZE 0x80000
   fi
   dep_tristate '  JEDEC Flash device mapped on Mixcom piggyback card' CONFIG_MTD_MIXMEM $CONFIG_MTD_JEDEC
   dep_tristate '  JEDEC Flash device mapped on Octagon 5066 SBC' CONFIG_MTD_OCTAGON $CONFIG_MTD_JEDEC
   dep_tristate '  JEDEC Flash device mapped on Tempustech VMAX SBC301' CONFIG_MTD_VMAX $CONFIG_MTD_JEDEC
   dep_tristate '  BIOS flash chip on Intel L440GX boards' CONFIG_MTD_L440GX $CONFIG_MTD_JEDECPROBE
   dep_tristate ' ROM connected to AMD766 southbridge' CONFIG_MTD_AMD766ROM $CONFIG_MTD_GEN_PROBE   
   dep_tristate ' ROM connected to Intel Hub Controller 2' CONFIG_MTD_ICH2ROM $CONFIG_MTD_JEDECPROBE
   dep_tristate '  CFI Flash device mapped on SnapGear/SecureEdge' CONFIG_MTD_NETtel $CONFIG_MTD_PARTITIONS
fi

if [ "$CONFIG_PPC" = "y" ]; then
   dep_tristate '  CFI Flash device mapped on TQM8XXL' CONFIG_MTD_TQM8XXL $CONFIG_MTD_CFI $CONFIG_TQM8xxL
   dep_tristate '  CFI Flash device mapped on RPX Lite or CLLF' CONFIG_MTD_RPXLITE $CONFIG_MTD_CFI
   dep_tristate '  System flash on MBX860 board' CONFIG_MTD_MBX860 $CONFIG_MTD_CFI
   dep_tristate '  CFI Flash device mapped on D-Box2' CONFIG_MTD_DBOX2 $CONFIG_MTD_CFI
   dep_tristate '  CFI Flash device mapping on FlagaDM' CONFIG_MTD_CFI_FLAGADM $CONFIG_MTD_CFI
   dep_tristate '  CFI Flash device mapped on IBM Redwood-4/5' CONFIG_MTD_REDWOOD $CONFIG_MTD_CFI
fi

if [ "$CONFIG_MIPS" = "y" ]; then
#@@@@@
   dep_tristate '  VR4181A flash device' CONFIG_MTD_VR4181A $CONFIG_VR4181A
#@@@@@
   dep_tristate '  Pb1000 MTD support' CONFIG_MTD_PB1000 $CONFIG_MIPS_PB1000
   dep_tristate '  Pb1500 MTD support' CONFIG_MTD_PB1500 $CONFIG_MIPS_PB1500
   dep_tristate '  Pb1100 MTD support' CONFIG_MTD_PB1100 $CONFIG_MIPS_PB1100
   if [ "$CONFIG_MTD_PB1500" = "y" -o "$CONFIG_MTD_PB1500" = "m" \
	-o "$CONFIG_MTD_PB1100" = "y" -o "$CONFIG_MTD_PB1100" = "m" ]; then
      bool '  Pb[15]00 boot flash device' CONFIG_MTD_PB1500_BOOT 
      bool '  Pb[15]00 user flash device (2nd 32MB bank)' CONFIG_MTD_PB1500_USER
   fi
   dep_tristate '  Flash chip mapping on ITE QED-4N-S01B, Globespan IVR or custom board' CONFIG_MTD_CSTM_MIPS_IXX $CONFIG_MTD_CFI $CONFIG_MTD_JEDEC $CONFIG_MTD_PARTITIONS 
   if [ "$CONFIG_MTD_CSTM_MIPS_IXX" = "y" -o "$CONFIG_MTD_CSTM_MIPS_IXX" = "m" ]; then
      hex '    Physical start address of flash mapping' CONFIG_MTD_CSTM_MIPS_IXX_START 0x8000000
      hex '    Physical length of flash mapping' CONFIG_MTD_CSTM_MIPS_IXX_LEN 0x4000000
      int '    Bus width in octets' CONFIG_MTD_CSTM_MIPS_IXX_BUSWIDTH 2
   fi
   dep_tristate '  Momenco Ocelot boot flash device' CONFIG_MTD_OCELOT $CONFIG_MOMENCO_OCELOT
   dep_tristate '  LASAT flash device' CONFIG_MTD_LASAT $CONFIG_MTD_CFI $CONFIG_LASAT
fi

if [ "$CONFIG_SUPERH" = "y" ]; then
   dep_tristate '  CFI Flash device mapped on Hitachi SolutionEngine' \
      CONFIG_MTD_SOLUTIONENGINE $CONFIG_MTD_PARTITIONS
   dep_tristate '  CFI Flash device mapped on Hitachi MS7760CP01' \
      CONFIG_MTD_MS7760CP $CONFIG_MTD_PARTITIONS
   dep_tristate '  CFI Flash device mapped on Hitachi MS7727RP02' \
      CONFIG_MTD_MS7727RP $CONFIG_MTD_PARTITIONS
   if [ "$CONFIG_MTD_SOLUTIONENGINE" != "n" ]; then
      hex '  Default reserved Flash size'  CONFIG_MTD_SUPERH_RESERVE 0x00010000
   fi
   dep_tristate '  CFI Flash device mapped on Renesas RTS7751R2D' \
      CONFIG_MTD_RTS7751R2D $CONFIG_MTD_PARTITIONS $CONFIG_MTD_CFI
   dep_tristate '  CFI Flash device mapped on Hitachi MS7710SE' \
      CONFIG_MTD_MS7710SE $CONFIG_MTD_PARTITIONS
   dep_tristate '  CFI Flash device mapped on Hitachi MS7720RP' \
      CONFIG_MTD_MS7720RP $CONFIG_MTD_PARTITIONS
fi

if [ "$CONFIG_ARM" = "y" ]; then
   dep_tristate '  CFI Flash device mapped on Lubbock board' CONFIG_MTD_LUBBOCK $CONFIG_MTD_CFI $CONFIG_ARCH_LUBBOCK $CONFIG_MTD_PARTITIONS
   dep_tristate '  CFI Flash device mapped on Nora' CONFIG_MTD_NORA $CONFIG_MTD_CFI
   dep_tristate '  CFI Flash device mapped on ARM Integrator/P720T' CONFIG_MTD_ARM_INTEGRATOR $CONFIG_MTD_CFI
   dep_tristate '  Cirrus CDB89712 evaluation board mappings' CONFIG_MTD_CDB89712 $CONFIG_MTD_CFI $CONFIG_ARCH_CDB89712
   dep_tristate '  CFI Flash device mapped on MX21 ADSBoard' CONFIG_MTD_MX2ADS $CONFIG_MTD_CFI $CONFIG_ARCH_MX2ADS $CONFIG_MTD_PARTITIONS
   dep_tristate '  CFI Flash device mapped on StrongARM SA11x0' CONFIG_MTD_SA1100 $CONFIG_MTD_CFI $CONFIG_ARCH_SA1100 $CONFIG_MTD_PARTITIONS
   dep_tristate '  CFI Flash device mapped on DC21285 Footbridge' CONFIG_MTD_DC21285 $CONFIG_MTD_CFI $CONFIG_ARCH_FOOTBRIDGE $CONFIG_MTD_PARTITIONS
   dep_tristate '  CFI Flash device mapped on the XScale IQ80310 board' CONFIG_MTD_IQ80310 $CONFIG_MTD_CFI $CONFIG_ARCH_IQ80310
   dep_tristate '  CFI Flash device mapped on the FortuNet board' CONFIG_MTD_FORTUNET $CONFIG_MTD_CFI $CONFIG_MTD_PARTITIONS $CONFIG_ARCH_FORTUNET
   dep_tristate '  CFI Flash device mapped on PXA CerfBoard' CONFIG_MTD_PXA_CERF $CONFIG_MTD_CFI $CONFIG_ARCH_PXA_CERF $CONFIG_MTD_PARTITIONS 
   dep_tristate '  CFI Flash device mapped on Epxa10db' CONFIG_MTD_EPXA10DB $CONFIG_MTD_CFI  $CONFIG_MTD_PARTITIONS $CONFIG_ARCH_CAMELOT
   dep_tristate '  NV-RAM mapping AUTCPU12 board' CONFIG_MTD_AUTCPU12 $CONFIG_ARCH_AUTCPU12
   dep_tristate '  CFI Flash device mapped on EDB7312' CONFIG_MTD_EDB7312 $CONFIG_ARCH_EDB7212 $CONFIG_MTD_CFI
   dep_tristate '  JEDEC Flash device mapped on impA7' CONFIG_MTD_IMPA7 $CONFIG_MTD_JEDECPROBE
   dep_tristate '  CFI Flash device mapped on Sabinal Discovery' CONFIG_MTD_DISCOVERY $CONFIG_MTD_CFI $CONFIG_ARCH_SABINAL $CONFIG_MTD_PARTITIONS
   dep_tristate '  Rom mapped on SHARP SL series' CONFIG_MTD_SHARP_SL $CONFIG_ARCH_SHARP_SL $CONFIG_MTD_PARTITIONS
   if [ "$CONFIG_XIP_KERNEL" = "y" ]; then
      dep_tristate '  AMD Flash device mapped on KATANA' CONFIG_MTD_XIP_KATANA $CONFIG_MTD_AMDSTD $CONFIG_MTD_PARTITIONS
   else
      dep_tristate '  AMD Flash device mapped on KATANA' CONFIG_MTD_KATANA $CONFIG_MTD_AMDSTD $CONFIG_MTD_PARTITIONS
   fi
   dep_tristate '  Flash device mapped on TPM102' CONFIG_MTD_TPM102 $CONFIG_DBMX1_TPM102 $CONFIG_MTD_PARTITIONS
fi

if [ "$CONFIG_ALPHA" = "y" ]; then
   dep_tristate '  Flash chip mapping on TSUNAMI' CONFIG_MTD_TSUNAMI $CONFIG_MTD_GENPROBE
fi

if [ "$CONFIG_UCLINUX" = "y" ]; then
   dep_tristate '  Generic uClinux RAM/ROM filesystem support' CONFIG_MTD_UCLINUX $CONFIG_MTD_PARTITIONS
fi

# This needs CFI or JEDEC, depending on the cards found.
dep_tristate '  PCI MTD driver' CONFIG_MTD_PCI $CONFIG_MTD $CONFIG_PCI

if [ "$CONFIG_M5272C3" ]; then
   dep_tristate '  CFI Flash device mapped on Motorola M5272C3' CONFIG_MTD_M5272C3 $CONFIG_MTD_CFI
fi


endmenu
```

## drivers/usbd/Config.in
```kconfig
#
# USB device configuration from the device viewpoint (e.g. Linux running inside a USB device, not as host)
#
# Copyright (C) 2001 Lineo, Inc.
# Copyright (C) 2001 Hewlett-Packard Co.
mainmenu_option next_comment

comment 'USB Device Support'

tristate 'Support for USB Devices (as device, not host)' CONFIG_USBD

if [ ! "$CONFIG_USBD" = "n" ]; then

	hex     '     VendorID (hex value)' CONFIG_USBD_VENDORID "0000"
	hex     '     ProductID (hex value)' CONFIG_USBD_PRODUCTID "0000"
	string  '     Product Name' CONFIG_USBD_PRODUCT_NAME "" 
	string  '     Manufacturer' CONFIG_USBD_MANUFACTURER "Lineo"

	bool    '     Use Serial Number in Device Descriptor' CONFIG_USBD_USE_SERIAL_NUMBER
	string  '     Default Serial number (string)' CONFIG_USBD_SERIAL_NUMBER_STR ""

	bool    '     Self Powered' CONFIG_USBD_SELFPOWERED
	if [ ! "$CONFIG_USBD_SELFPOWERED" = "y" ]; then
	    	int     '     Max Power (mA)' CONFIG_USBD_MAXPOWER "0"
	fi

	tristate '  USB Device Monitor' CONFIG_USBD_MONITOR

	comment ''


	bool 	'  USBD Proc FS' CONFIG_USBD_PROCFS $CONFIG_USBD

	
	comment 'USB Device functions --'

	source drivers/usbd/net_fd/Config.in
	source drivers/usbd/serial_fd/Config.in
	
	comment 'USB Device bus interfaces --'



	# StrongArm
	if [ "$CONFIG_ARCH_SA1100" = "y" ]; then
	    	source drivers/usbd/sa1100_bi/Config.in
	fi

	# Linkup
	if [ "$CONFIG_ARCH_L7200" = "y" ]; then
	    	source drivers/usbd/l7205_bi/Config.in
	fi

	# CDSP
	if [ "$CONFIG_MIPS_SEAD" = "y" ]; then
	    	source drivers/usbd/cdsp_bi/Config.in
	fi

	# Scanlogic
	if [ "$CONFIG_SUPERH" = "y" -o "$CONFIG_X86" = "y" ]; then
	    	source drivers/usbd/sl11_bi/Config.in
	fi

	# Hitachi SH7622 or SH7727
	if [ "$CONFIG_CPU_SUBTYPE_SH7622" = "y" -o "$CONFIG_CPU_SUBTYPE_SH7727" = "y" ]; then
	    	source drivers/usbd/superh_bi/Config.in
	fi

	source drivers/usbd/gen_bi/Config.in
fi

endmenu
```

## lib/Config.in
```kconfig
#
# Library configuration
#
mainmenu_option next_comment
comment 'Library routines'

tristate 'zlib decompression support' CONFIG_ZLIB_INFLATE
tristate 'zlib compression support' CONFIG_ZLIB_DEFLATE

source crypto/Config.in

endmenu
```
