## arch/shnommu/config.in
```kconfig
#
# For a description of the syntax of this configuration file,
# see Documentation/kbuild/config-language.txt.
#
mainmenu_name "Linux Kernel Configuration"

define_bool CONFIG_SH2 y
define_bool CONFIG_SH_GENERIC y
define_bool CONFIG_UID16 y

# Begin uclinux additions -----------------------------------------------------
define_bool CONFIG_UCLINUX y
define_bool NO_MM y
define_bool MAGIC_ROM_PTR y
# End uclinux additions -------------------------------------------------------


#------------------------------------------------------------------------------
#                         C o d e    m a t u r i t y
#------------------------------------------------------------------------------
mainmenu_option next_comment
comment 'Code maturity level options'
bool 'Prompt for development and/or incomplete code/drivers' CONFIG_EXPERIMENTAL
bool 'Prompt for obsolete code/drivers' CONFIG_OBSOLETE
endmenu
#------------------------------------------------------------------------------
#                      L o a d a b l e    M o d u l e
#------------------------------------------------------------------------------
mainmenu_option next_comment
comment 'Loadable module support'
bool 'Enable loadable module support' CONFIG_MODULES
if [ "$CONFIG_MODULES" = "y" ]; then
   bool '  Set version information on all module symbols' CONFIG_MODVERSIONS
   bool '  Kernel module loader' CONFIG_KMOD
fi
endmenu
#------------------------------------------------------------------------------
#                               S y s t e m
#------------------------------------------------------------------------------
mainmenu_option next_comment
comment 'System Type'
choice 'SH system type'	\
	 "MS7615SE		CONFIG_ARCH_MS7615SE"
endmenu
if [ "$CONFIG_ARCH_MS7615SE" = "y" ]; then
   define_bool CONFIG_CPU_SH2 y
   define_bool CONFIG_NO_PGT_CACHE y
   define_hex DRAM_BASE 0x06000000
   define_hex DRAM_SIZE 0x00200000
   define_hex FLASH_MEM_BASE 0x01000000
   define_hex FLASH_SIZE 0x00200000
   define_bool CONFIG_DUMMY_CONSOLE y
fi
#------------------------------------------------------------------------------
#                             G e n e r a l
#------------------------------------------------------------------------------
mainmenu_option next_comment
comment 'General setup'
source drivers/pci/Config.in
bool 'Support hot-pluggable devices' CONFIG_HOTPLUG
if [ "$CONFIG_HOTPLUG" = "y" ]; then
   source drivers/pcmcia/Config.in
else
   define_bool CONFIG_PCMCIA n
fi
bool 'Networking support' CONFIG_NET
bool 'System V IPC' CONFIG_SYSVIPC
bool 'Reduced memory footprint' CONFIG_REDUCED_MEMORY
bool 'BSD Process Accounting' CONFIG_BSD_PROCESS_ACCT
bool 'Sysctl support' CONFIG_SYSCTL
choice 'Kernel core (/proc/kcore) format' \
	"ELF		CONFIG_KCORE_ELF	\
	 A.OUT		CONFIG_KCORE_AOUT" ELF
	 
define_bool CONFIG_BINFMT_FLAT y
define_bool CONFIG_KERNEL_ELF y

if [ "$CONFIG_EXPERIMENTAL" = "y" ]; then
   bool 'Power Management support' CONFIG_PM
fi

if [ "$CONFIG_ARCH_MS7615SE" = "y"]; then
   string 'Default kernel command string' CONFIG_CMDLINE ""
fi
if [ "$CONFIG_ARCH_MS7615SE" = "y" ]; then
   bool 'Timer and CPU usage LEDs' CONFIG_LEDS
   if [ "$CONFIG_LEDS" = "y" ]; then
         bool '  Timer LED' CONFIG_LEDS_TIMER
         bool '  CPU usage LED' CONFIG_LEDS_CPU
   fi
fi
endmenu
#------------------------------------------------------------------------------
#                           N e t    D e v i c e s
#------------------------------------------------------------------------------
if [ "$CONFIG_NET" = "y" ]; then
   source net/Config.in
   mainmenu_option next_comment
   comment 'Network device support'
   bool 'Network device support?' CONFIG_NETDEVICES
   if [ "$CONFIG_NETDEVICES" = "y" ]; then
      source drivers/net/Config.in
   fi
   endmenu
#   source net/ax25/Config.in
#   source net/irda/Config.in
fi
#------------------------------------------------------------------------------
#                               A T E / I D E
#------------------------------------------------------------------------------
mainmenu_option next_comment
comment 'ATA/IDE/MFM/RLL support'
tristate 'ATA/IDE/MFM/RLL support' CONFIG_IDE
if [ "$CONFIG_IDE" != "n" ]; then
  source drivers/ide/Config.in
else
  define_bool CONFIG_BLK_DEV_IDE_MODES n
  define_bool CONFIG_BLK_DEV_HD n
fi
endmenu
#------------------------------------------------------------------------------
#                                  I S D N
#------------------------------------------------------------------------------
mainmenu_option next_comment
comment 'ISDN subsystem'
tristate 'ISDN support' CONFIG_ISDN
if [ "$CONFIG_ISDN" != "n" ]; then
   source drivers/isdn/Config.in
fi
endmenu
#------------------------------------------------------------------------------
#                              C o n s o l e
#------------------------------------------------------------------------------
if [ "$CONFIG_VT" = "y" ]; then
   mainmenu_option next_comment
   comment 'Console drivers'
   source drivers/video/Config.in
   endmenu
fi

#------------------------------------------------------------------------------
#                        M i s c    D r i v e r s
#------------------------------------------------------------------------------
source drivers/parport/Config.in
source drivers/mtd/Config.in
source drivers/pnp/Config.in
source drivers/block/Config.in
source fs/Config.in
source drivers/char/Config.in
source drivers/usb/Config.in
#source drivers/ieee1394/Config.in
#source drivers/i2o/Config.in
#------------------------------------------------------------------------------
#                     K e r n e l    H a c k i n g
#------------------------------------------------------------------------------
mainmenu_option next_comment
comment 'Kernel hacking'

define_bool CONFIG_FRAME_POINTER y
bool 'Find REVISITS' CONFIG_REVISIT
bool 'Verbose kernel error messages' CONFIG_DEBUG_ERRORS
bool 'Verbose user fault messages' CONFIG_DEBUG_USER
bool 'Include debugging information in kernel binary' CONFIG_DEBUG_INFO
dep_bool 'Magic SysRq key' CONFIG_MAGIC_SYSRQ $CONFIG_VT
if [ "$CONFIG_EXPERIMENTAL" = "y" ]; then
   bool 'Kernel low-level debugging functions' CONFIG_DEBUG_LL
fi
endmenu
```

## arch/um/config.in
```kconfig
define_bool CONFIG_USERMODE y

mainmenu_name "Linux/Usermode Kernel Configuration"

define_bool CONFIG_ISA y
define_bool CONFIG_SBUS n

define_bool CONFIG_UID16 y

define_bool CONFIG_RWSEM_XCHGADD_ALGORITHM y
define_bool CONFIG_GENERIC_BUST_SPINLOCK n
define_bool CONFIG_GENERIC_ISA_DMA y

mainmenu_option next_comment
comment 'Code maturity level options'
bool 'Prompt for development and/or incomplete code/drivers' CONFIG_EXPERIMENTAL
endmenu

mainmenu_option next_comment
comment 'Processor features'
comment 'General Setup'
define_bool CONFIG_STDIO_CONSOLE y
bool 'Networking support' CONFIG_NET
bool 'System V IPC' CONFIG_SYSVIPC
bool 'BSD Process Accounting' CONFIG_BSD_PROCESS_ACCT
bool 'Sysctl support' CONFIG_SYSCTL
tristate 'Kernel support for a.out binaries' CONFIG_BINFMT_AOUT
tristate 'Kernel support for ELF binaries' CONFIG_BINFMT_ELF
tristate 'Kernel support for MISC binaries' CONFIG_BINFMT_MISC
bool 'Unix98 PTY support' CONFIG_UNIX98_PTYS
if [ "$CONFIG_UNIX98_PTYS" = "y" ]; then
   int 'Maximum number of Unix98 PTYs in use (0-2048)' CONFIG_UNIX98_PTY_COUNT 256
fi
bool 'Virtual serial line' CONFIG_SSL
tristate 'Host filesystem' CONFIG_HOSTFS
bool 'Management console' CONFIG_MCONSOLE
dep_bool 'Magic SysRq key' CONFIG_MAGIC_SYSRQ $CONFIG_MCONSOLE
bool '2G/2G host address space split' CONFIG_HOST_2G_2G
endmenu

mainmenu_option next_comment
comment 'Loadable module support'
bool 'Enable loadable module support' CONFIG_MODULES
if [ "$CONFIG_MODULES" = "y" ]; then
# MODVERSIONS does not yet work in this architecture
#   bool '  Set version information on all module symbols' CONFIG_MODVERSIONS
    bool '  Kernel module loader' CONFIG_KMOD
fi
endmenu

# SMP doesn't work in UML yet
#mainmenu_option next_comment
#comment 'Processor features'
# bool 'Symmetric multi-processing support' CONFIG_SMP
#endmenu

mainmenu_option next_comment
comment 'Devices'
define_bool CONFIG_BLK_DEV_UBD y
bool 'Always do synchronous disk IO for UBD' CONFIG_BLK_DEV_UBD_SYNC
tristate 'Loopback device support' CONFIG_BLK_DEV_LOOP
dep_tristate 'Network block device support' CONFIG_BLK_DEV_NBD $CONFIG_NET
tristate 'RAM disk support' CONFIG_BLK_DEV_RAM
if [ "$CONFIG_BLK_DEV_RAM" = "y" -o "$CONFIG_BLK_DEV_RAM" = "m" ]; then
	int '   Default RAM disk size' CONFIG_BLK_DEV_RAM_SIZE 4096
fi
dep_bool '  Initial RAM disk (initrd) support' CONFIG_BLK_DEV_INITRD $CONFIG_BLK_DEV_RAM
tristate 'Example IO memory driver' CONFIG_MMAPPER
endmenu

if [ "$CONFIG_NET" = "y" ]; then
   source net/Config.in
fi

mainmenu_option next_comment
comment 'Network drivers'
if [ "$CONFIG_NET" = "y" ]; then
   source drivers/net/Config.in
fi
endmenu

if [ "$CONFIG_NET" = "y" ]; then
   mainmenu_option next_comment
   comment 'Network device support'

   bool '  Virtual network device support' CONFIG_UML_NET
   if [ "$CONFIG_UML_NET" != "n" ]; then
      bool '    Ethertap transport' CONFIG_UML_NET_ETHERTAP
      bool '    TUN/TAP transport' CONFIG_UML_NET_TUNTAP
      bool '    SLIP transport' CONFIG_UML_NET_SLIP
      bool '    Daemon transport' CONFIG_UML_NET_DAEMON
      bool '    Multicast transport' CONFIG_UML_NET_MCAST
   fi
   endmenu
fi

source fs/Config.in

mainmenu_option next_comment
comment 'Kernel hacking'
bool 'Enable kernel debugging symbols' CONFIG_DEBUGSYM
dep_bool 'Enable ptrace proxy' CONFIG_PT_PROXY $CONFIG_DEBUGSYM
dep_bool 'Enable gprof support' CONFIG_GPROF $CONFIG_DEBUGSYM
dep_bool 'Enable gcov support' CONFIG_GCOV $CONFIG_DEBUGSYM
endmenu
```
